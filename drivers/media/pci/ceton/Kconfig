## drivers/media/pci/ceton/Kconfig
```kconfig
config VIDEO_CETON
	tristate "Ceton CableCard PCI DVB Video For Linux"
	depends on DVB_CORE && PCI && I2C
	help
	  Say Y for support for Ceton InfiniTV CableCard PCI DVB.

	  To compile this driver as a module, choose M here: the
	  module will be called ctn91xx.
```
